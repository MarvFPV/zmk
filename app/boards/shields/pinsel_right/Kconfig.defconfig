## app/boards/shields/pinsel_right/Kconfig.defconfig
```kconfig
# Copyright (c) 2020 The ZMK Contributors
# SPDX-License-Identifier: MIT

if SHIELD_PINSEL_RIGHT

config ZMK_KEYBOARD_NAME
    default "PINSEL_RIGHT"

endif
```

## app/boards/shields/pinsel_right/Kconfig.shield
```kconfig
# Copyright (c) 2020 The ZMK Contributors
# SPDX-License-Identifier: MIT

config SHIELD_PINSEL_RIGHT
   def_bool $(shields_list_contains,pinsel_right)
```
