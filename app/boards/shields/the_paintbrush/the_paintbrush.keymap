/*
 * Copyright (c) 2021 Mike "KemoNine" Crosson
 *
 * SPDX-License-Identifier: MIT
 */

#include <behaviors.dtsi>
#include <dt-bindings/zmk/keys.h>
#include <dt-bindings/zmk/bt.h>

// THE BOARD IS FLIPPED FOR LEFT BUT STILL WIRED RIGHT!
#define ARTSEY_LEFT 1




#if ARTSEY_LEFT
// ARTS Row
#define KEY_A 3
#define KEY_R 2
#define KEY_T 1
#define KEY_S 0
// EYIO Row
#define KEY_E 7
#define KEY_Y 6
#define KEY_I 5
#define KEY_O 4
#endif

#if ARTSEY_RIGHT
// ARTS Row
#define KEY_A 0
#define KEY_R 1
#define KEY_T 2
#define KEY_S 3
// EYIO Row
#define KEY_E 4
#define KEY_Y 5
#define KEY_I 6
#define KEY_O 7
#endif

// Define Offsets
#define LEADING_NONES NONE(0,0,0)
#define MIDDLE_NONES NONE(0, 0, 0)
#define TRAILING_NONES NONE(0, 0, 0)

// Include main artsey.io keymap
#include "../../artsey.dtsi"

// Manage bluetooth profiles
/ {
	combos {
		compatible = "zmk,combos";
		chord_bt_nxt { key-positions = <KEY_A KEY_E KEY_S KEY_O>; bindings = <&bt BT_NXT>; };
		chord_bt_clr { key-positions = <KEY_R KEY_Y KEY_T KEY_I>; bindings = <&bt BT_CLR>; };
	};
};